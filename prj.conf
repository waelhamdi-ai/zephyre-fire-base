## CMakeLists.txt
```
# SPDX-License-Identifier: Apache-2.0

cmake_minimum_required(VERSION 3.20.0)
find_package(Zephyr REQUIRED HINTS $ENV{ZEPHYR_BASE})
project(http_client)

FILE(GLOB app_sources src/*.c)
target_sources(app PRIVATE ${app_sources})

set(gen_dir ${ZEPHYR_BINARY_DIR}/include/generated/)

generate_inc_file_for_target(
    app
    src/https-cert.der
    ${gen_dir}/https-cert.der.inc
    )
```

## Kconfig
```
# Private config options for http-client sample app

# Copyright (c) 2020 Intel Corporation
# SPDX-License-Identifier: Apache-2.0

mainmenu "Networking http-client sample application"

config NET_SAMPLE_SEND_ITERATIONS
	int "Send a sample HTTP query this many times"
	default 0
	help
	  Send a sample HTTP query this many times before exiting. A value of
	  zero means that the sample application in default way.

source "Kconfig.zephyr"
```

## sample.yaml
```
common:
  tags:
    - net
    - http
    - http_client
  min_ram: 32
  depends_on: netif
sample:
  description: HTTP client sample
  name: http_client
tests:
  sample.net.sockets.http_client:
    harness: net
```

## prj.conf
```kconfig
# General config
CONFIG_MAIN_STACK_SIZE=4096
CONFIG_SYSTEM_WORKQUEUE_STACK_SIZE=2048

# Networking config
CONFIG_NETWORKING=y
CONFIG_NET_IPV4=y
CONFIG_NET_TCP=y
CONFIG_NET_SHELL=y

# Native ESP32 WiFi support (replacing ESP-AT)
CONFIG_WIFI=y
CONFIG_ESP32_WIFI=y
CONFIG_NET_L2_WIFI_MGMT=y
CONFIG_NET_DHCPV4=y

# Sockets
CONFIG_NET_SOCKETS=y
CONFIG_NET_SOCKETS_POSIX_NAMES=y
CONFIG_POSIX_API=y

# TLS support (required for Firebase)
CONFIG_MBEDTLS=y
CONFIG_MBEDTLS_BUILTIN=y
CONFIG_MBEDTLS_ENABLE_HEAP=y
CONFIG_MBEDTLS_HEAP_SIZE=60000
CONFIG_MBEDTLS_SSL_MAX_CONTENT_LEN=4096
CONFIG_NET_SOCKETS_SOCKOPT_TLS=y
CONFIG_NET_SOCKETS_TLS_MAX_CONTEXTS=6

# Network buffers
CONFIG_NET_PKT_RX_COUNT=16
CONFIG_NET_PKT_TX_COUNT=16
CONFIG_NET_BUF_RX_COUNT=128
CONFIG_NET_BUF_TX_COUNT=128
CONFIG_NET_CONTEXT_NET_PKT_POOL=y

# HTTP
CONFIG_HTTP_CLIENT=y

# JSON library for Firebase data
CONFIG_JSON_LIBRARY=y

# Logging
CONFIG_LOG=y

# ESP32 component requirements
CONFIG_HEAP_MEM_POOL_SIZE=65535
```

## ieee802154-overlay.conf
```kconfig
CONFIG_NET_L2_IEEE802154=y
CONFIG_NET_L2_IEEE802154_SHELL=y
CONFIG_NET_L2_IEEE802154_LOG_LEVEL_INF=y

# 2.4G by default, SubG bands require additional driver support,
# see *-enable-subg.overlay
# Uncomment for 868 MHz
#CONFIG_NET_CONFIG_IEEE802154_CHANNEL=0
# Uncomment for 906 MHz:
#CONFIG_NET_CONFIG_IEEE802154_CHANNEL=1

CONFIG_NET_MGMT_EVENT_STACK_SIZE=2048
CONFIG_NET_L2_IEEE802154_FRAGMENT_REASS_CACHE_SIZE=3

#Debugging
CONFIG_NET_L2_IEEE802154_LOG_LEVEL_DBG=n
```

## overlay-tls.conf
```kconfig
CONFIG_MAIN_STACK_SIZE=3072
CONFIG_NET_BUF_RX_COUNT=80
CONFIG_NET_BUF_TX_COUNT=80

# TLS configuration
CONFIG_MBEDTLS=y
CONFIG_MBEDTLS_BUILTIN=y
CONFIG_MBEDTLS_ENABLE_HEAP=y
CONFIG_MBEDTLS_HEAP_SIZE=60000
CONFIG_MBEDTLS_SSL_MAX_CONTENT_LEN=2048

CONFIG_NET_SOCKETS_SOCKOPT_TLS=y
CONFIG_NET_SOCKETS_TLS_MAX_CONTEXTS=6
```

## cc1352-enable-subg.overlay
```dts
/*
 * SPDX-License-Identifier: Apache-2.0
 */

/**
 * Overlay to enable for CC1352R1 / CC1352P1-based boards.
 */

/ {
	chosen {
		zephyr,ieee802154 = &ieee802154g;
	};
};

&ieee802154 {
	status = "disabled";
};

&ieee802154g {
	status = "okay";
};
```

## boards/esp32_devkitc_wroom.overlay
```dts
/ {
    chosen {
        zephyr,wifi = &uart1;
    };
};

&uart1 {
    status = "okay";
    current-speed = <115200>;
};
```

## src/main.c
```c
/*
 * Copyright (c) 2019 Intel Corporation
 *
 * SPDX-License-Identifier: Apache-2.0
 */

#include <zephyr/logging/log.h>
LOG_MODULE_REGISTER(net_http_client_sample, LOG_LEVEL_DBG);

#include <zephyr/kernel.h>
#include <zephyr/net/net_ip.h>
#include <zephyr/net/socket.h>
#include <zephyr/net/tls_credentials.h>
#include <zephyr/net/http/client.h>

#include "ca_certificate.h"
#include "wifi_connect.h"
#include "firebase_config.h"

#define MAX_RECV_BUF_LEN 2048
static uint8_t recv_buf[MAX_RECV_BUF_LEN];

static void response_cb(struct http_response *rsp,
             enum http_final_call final_data,
             void *user_data)
{
    if (final_data == HTTP_DATA_MORE) {
        LOG_INF("Partial data received (%zd bytes)", rsp->data_len);
    } else if (final_data == HTTP_DATA_FINAL) {
        LOG_INF("All the data received (%zd bytes)", rsp->data_len);
    }

    LOG_INF("Response to %s", (const char *)user_data);
    LOG_INF("Response status %s", rsp->http_status);
    
    // Fix: In Zephyr's HTTP client, response data is in the recv_buf, not in rsp->data
    if (rsp->data_len > 0) {
        LOG_INF("Payload: %.*s", (int)rsp->data_len, (char *)recv_buf);
    } else {
        LOG_INF("No payload received");
    }
}

static int connect_to_firebase(void)
{
    struct sockaddr_in addr4;
    int sock = -1;
    int32_t timeout = 10 * MSEC_PER_SEC;
    int ret;

    // Register certificates
    ret = tls_credential_add(CA_CERTIFICATE_TAG,
                 TLS_CREDENTIAL_CA_CERTIFICATE,
                 ca_certificate,
                 sizeof(ca_certificate));
    if (ret < 0) {
        LOG_ERR("Failed to register certificate: %d", ret);
        return ret;
    }

    // Setup socket
    sock = socket(AF_INET, SOCK_STREAM, IPPROTO_TLS_1_2);
    if (sock < 0) {
        LOG_ERR("Failed to create HTTPS socket (%d)", -errno);
        return -errno;
    }

    // Configure TLS
    sec_tag_t sec_tag_list[] = {
        CA_CERTIFICATE_TAG,
    };

    ret = setsockopt(sock, SOL_TLS, TLS_SEC_TAG_LIST,
                    sec_tag_list, sizeof(sec_tag_list));
    if (ret < 0) {
        LOG_ERR("Failed to set TLS_SEC_TAG_LIST option (%d)", -errno);
        close(sock);
        return -errno;
    }

    ret = setsockopt(sock, SOL_TLS, TLS_HOSTNAME,
                    TLS_PEER_HOSTNAME, sizeof(TLS_PEER_HOSTNAME));
    if (ret < 0) {
        LOG_ERR("Failed to set TLS_HOSTNAME option (%d)", -errno);
        close(sock);
        return -errno;
    }

    // Connect to Firebase
    memset(&addr4, 0, sizeof(addr4));
    addr4.sin_family = AF_INET;
    addr4.sin_port = htons(FIREBASE_PORT);
    
    ret = zsock_getaddrinfo(FIREBASE_HOST, NULL, NULL, (struct zsock_addrinfo **)&addr4.sin_addr);
    if (ret < 0) {
        LOG_ERR("Failed to resolve %s (%d)", FIREBASE_HOST, -errno);
        close(sock);
        return -errno;
    }

    ret = connect(sock, (struct sockaddr *)&addr4, sizeof(addr4));
    if (ret < 0) {
        LOG_ERR("Failed to connect to Firebase (%d)", -errno);
        close(sock);
        return -errno;
    }

    LOG_INF("Connected to Firebase");
    return sock;
}

static int send_data_to_firebase(void)
{
    int sock;
    int ret;
    int32_t timeout = 10 * MSEC_PER_SEC;
    
    // Connect to Firebase
    sock = connect_to_firebase();
    if (sock < 0) {
        return sock;
    }

    // Prepare JSON data to send
    const char *json_data = "{\"temperature\": 25.5, \"humidity\": 60}";
    
    // Prepare HTTP request
    struct http_request req;
    memset(&req, 0, sizeof(req));

    // For PUT request (to set data)
    req.method = HTTP_PUT;
    req.url = FIREBASE_DB_URL;
    req.host = FIREBASE_HOST;
    req.protocol = "HTTP/1.1";
    req.payload = json_data;
    req.payload_len = strlen(json_data);
    req.response = response_cb;
    req.recv_buf = recv_buf;
    req.recv_buf_len = sizeof(recv_buf);
    
    // Optional: Add authentication header if needed
    const char *headers[] = {
        "Content-Type: application/json\r\n",
        NULL
    };
    req.header_fields = headers;

    // Send request
    ret = http_client_req(sock, &req, timeout, "Firebase PUT");

    close(sock);
    return ret;
}

static int read_data_from_firebase(void)
{
    int sock;
    int ret;
    int32_t timeout = 10 * MSEC_PER_SEC;
    
    // Connect to Firebase
    sock = connect_to_firebase();
    if (sock < 0) {
        return sock;
    }

    // Prepare HTTP request for reading data
    struct http_request req;
    memset(&req, 0, sizeof(req));

    req.method = HTTP_GET;
    req.url = FIREBASE_DB_URL;
    req.host = FIREBASE_HOST;
    req.protocol = "HTTP/1.1";
    req.response = response_cb;
    req.recv_buf = recv_buf;
    req.recv_buf_len = sizeof(recv_buf);

    // Send request
    ret = http_client_req(sock, &req, timeout, "Firebase GET");

    close(sock);
    return ret;
}

int main(void)
{
    int ret;

    LOG_INF("HTTP Firebase Client Sample");
    
    // Connect to Wi-Fi
    LOG_INF("Connecting to Wi-Fi...");
    ret = wifi_connect();
    if (ret < 0) {
        LOG_ERR("Failed to connect to Wi-Fi: %d", ret);
        return ret;
    }
    LOG_INF("Connected to Wi-Fi");
    
    // Small delay to ensure network is ready
    k_sleep(K_SECONDS(2));

    // Send data to Firebase
    LOG_INF("Sending data to Firebase...");
    ret = send_data_to_firebase();
    if (ret < 0) {
        LOG_ERR("Failed to send data to Firebase: %d", ret);
        return ret;
    }
    
    // Read data from Firebase
    LOG_INF("Reading data from Firebase...");
    ret = read_data_from_firebase();
    if (ret < 0) {
        LOG_ERR("Failed to read data from Firebase: %d", ret);
        return ret;
    }
    
    LOG_INF("Firebase operations completed successfully");
    return 0;
}
```

## src/ca_certificate.h
```c
/*
 * Copyright (c) 2019 Intel Corporation
 *
 * SPDX-License-Identifier: Apache-2.0
 */

/*
 * Google Internet Authority G3 certificate for *.firebaseio.com
 */

#define TLS_PEER_HOSTNAME "firebaseio.com"
#define CA_CERTIFICATE_TAG 1

static const unsigned char ca_certificate[] = {
    /* Google's CA certificate - replace with a proper one */
    "-----BEGIN CERTIFICATE-----\n"
    "MIIDujCCAqKgAwIBAgILBAAAAAABD4Ym5g0wDQYJKoZIhvcNAQEFBQAwTDEgMB4G\n"
    "A1UECxMXR2xvYmFsU2lnbiBSb290IENBIC0gUjIxEzARBgNVBAoTCkdsb2JhbFNp\n"
    "Z24xEzARBgNVBAMTCkdsb2JhbFNpZ24wHhcNMDYxMjE1MDgwMDAwWhcNMjExMjE1\n"
    "MDgwMDAwWjBMMSAwHgYDVQQLExdHbG9iYWxTaWduIFJvb3QgQ0EgLSBSMjETMBEG\n"
    "A1UEChMKR2xvYmFsU2lnbjETMBEGA1UEAxMKR2xvYmFsU2lnbjCCASIwDQYJKoZI\n"
    "hvcNAQEBBQADggEPADCCAQoCggEBAKbPJA6+Lm8omUVCxKs+IVSbC9N/hHD6ErPL\n"
    "v4dfxn+G07IwXNb9rfF73OX4YJYJkhD10FPe+3t+c4isUoh7SqbKSaZeqKeMWhG8\n"
    "eoLrvozps6yWJQeXSpkqBy+0Hne/ig+1AnwblrjFuTosvNYSuetZfeLQBoZfXklq\n"
    "tTleiDTsvHgMCJiEbKjNS7SgfQx5TfC4LcshytVsW33hoCmEofnTlEnLJGKRILzd\n"
    "C9XZzPnqJworc5HGnRusyMvo4KD0L5CLTfuwNhv2GXqF4G3yYROIXJ/gkwpRl4pa\n"
    "zq+r1feqCapgvdzZX99yqWATXgAByUr6P6TqBwMhAo6CygPCm48CAwEAAaOBnDCB\n"
    "mTAOBgNVHQ8BAf8EBAMCAQYwDwYDVR0TAQH/BAUwAwEB/zAdBgNVHQ4EFgQUm+IH\n"
    "V2ccHsBqBt5ZtJot39wZhi4wNgYDVR0fBC8wLTAroCmgJ4YlaHR0cDovL2NybC5n\n"
    "bG9iYWxzaWduLm5ldC9yb290LXIyLmNybDAfBgNVHSMEGDAWgBSb4gdXZxwewGoG\n"
    "3lm0mi3f3BmGLjANBgkqhkiG9w0BAQUFAAOCAQEAmYFThxxol4aR7OBKuEQLq4Gs\n"
    "J0/WwbgcQ3izDJr86iw8bmEbTUsp9Z8FHSbBuOmDAGJFtqkIk7mpM0sYmsL4h4hO\n"
    "291xNBrBVNpGP+DTKqttVCL1OmLNIG+6KYnX3ZHu01yiPqFbQfXf5WRDLenVOavS\n"
    "ot+3i9DAgBkcRcAtjOj4LaR0VknFBbVPFd5uRHg5h6h+u/N5GJG79G+dwfCMNYxd\n"
    "AfvDbbnvRG15RjF+Cv6pgsH/76tuIMRQyV+dTZsXjAzlAcmgQWpzU/qlULRuJQ/7\n"
    "TBj0/VLZjmmx6BEP3ojY+x1J96relc8geMJgEtslQIxq/H5COEBkEveegeGTLg==\n"
    "-----END CERTIFICATE-----\n"
};
```

## src/firebase_config.h
```c
#ifndef FIREBASE_CONFIG_H
#define FIREBASE_CONFIG_H

/* Firebase project details */
#define FIREBASE_HOST        "rtos-11b4c-default-rtdb.europe-west1.firebasedatabase.app" 
#define FIREBASE_API_KEY     "Xw0b1rOhpIxIgS9wYn08YD0CJ1EhfNh5rvFUpCqP"
#define FIREBASE_PROJECT_ID  "rtos-11b4c"

/* HTTPS port for Firebase */
#define FIREBASE_PORT        443

/* Firebase database URL paths */
#define FIREBASE_DB_URL      "/data.json"  // Change to your specific database path

#endif /* FIREBASE_CONFIG_H */
```

## src/wifi_connect.c
```c
#include <zephyr/logging/log.h>
LOG_MODULE_REGISTER(wifi_connect, LOG_LEVEL_DBG);

#include <zephyr/kernel.h>
#include <zephyr/device.h>
#include <zephyr/net/net_if.h>
#include <zephyr/net/net_core.h>
#include <zephyr/net/net_context.h>
#include <zephyr/net/net_mgmt.h>
#include <zephyr/net/wifi_mgmt.h>

#include "wifi_connect.h"

/* Wi-Fi connection parameters */
#define WIFI_SSID "TT_2748"
#define WIFI_PSK "gdblpss7zc"

static K_SEM_DEFINE(wifi_connected, 0, 1);

static void wifi_mgmt_event_handler(struct net_mgmt_event_callback *cb,
                                  uint32_t mgmt_event, struct net_if *iface)
{
    if (mgmt_event == NET_EVENT_WIFI_CONNECT_RESULT) {
        LOG_INF("WiFi connected!");
        k_sem_give(&wifi_connected);
    } else if (mgmt_event == NET_EVENT_WIFI_DISCONNECT_RESULT) {
        LOG_INF("WiFi disconnected");
    }
}

int wifi_connect(void)
{
    struct net_if *iface;
    static struct net_mgmt_event_callback wifi_cb;
    struct wifi_connect_req_params wifi_params = {0};
    int ret;

    LOG_INF("Setting up WiFi connection");

    /* Get network interface */
    iface = net_if_get_default();
    if (!iface) {
        LOG_ERR("No network interface found");
        return -ENODEV;
    }

    /* Register for WiFi connect/disconnect events */
    net_mgmt_init_event_callback(&wifi_cb, wifi_mgmt_event_handler,
                               NET_EVENT_WIFI_CONNECT_RESULT |
                               NET_EVENT_WIFI_DISCONNECT_RESULT);
    net_mgmt_add_event_callback(&wifi_cb);

    /* Configure WiFi connection parameters */
    wifi_params.ssid = WIFI_SSID;
    wifi_params.ssid_length = strlen(WIFI_SSID);
    wifi_params.psk = WIFI_PSK;
    wifi_params.psk_length = strlen(WIFI_PSK);
    wifi_params.channel = WIFI_CHANNEL_ANY;
    wifi_params.security = WIFI_SECURITY_TYPE_PSK;

    /* Connect to WiFi network */
    LOG_INF("Connecting to SSID: %s", WIFI_SSID);
    ret = net_mgmt(NET_REQUEST_WIFI_CONNECT, iface, &wifi_params, sizeof(wifi_params));
    if (ret) {
        LOG_ERR("Failed to request WiFi connect: %d", ret);
        return ret;
    }

    /* Wait for connection */
    ret = k_sem_take(&wifi_connected, K_SECONDS(30));
    if (ret) {
        LOG_ERR("Connection to WiFi timed out");
        return -ETIMEDOUT;
    }

    /* Start DHCP to get IP address */
    LOG_INF("Starting DHCP");
    net_dhcpv4_start(iface);

    /* Wait for IP address */
    k_sleep(K_SECONDS(5));

    /* Print IP address */
    struct net_if_ipv4 *ipv4 = iface->config.ip.ipv4;
    if (ipv4 && ipv4->unicast[0].is_used) {
        char ip_str[NET_IPV4_ADDR_LEN];
        LOG_INF("IPv4 address: %s",
                net_addr_ntop(AF_INET, &ipv4->unicast[0].address.in_addr,
                            ip_str, sizeof(ip_str)));
    } else {
        LOG_WRN("No IPv4 address assigned");
    }

    return 0;
}
```

## src/wifi_connect.h
```c
#ifndef WIFI_CONNECT_H
#define WIFI_CONNECT_H

#include <zephyr/kernel.h>

/* 
 * Connect to Wi-Fi network
 * Returns 0 on success, negative error code on failure
 */
int wifi_connect(void);

#endif /* WIFI_CONNECT_H */
```
